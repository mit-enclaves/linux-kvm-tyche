## Kconfig
```kconfig
# SPDX-License-Identifier: GPL-2.0
#
# For a description of the syntax of this configuration file,
# see Documentation/kbuild/kconfig-language.rst.
#
mainmenu "Linux/$(ARCH) $(KERNELVERSION) Kernel Configuration"

# Define whether the kernel is meant to run confidentially
config CONFIDENTIAL_VM
    bool "Enable confidential VM support"
    default n
    help
      This signals paravirtualization for confidential VMs.

source "scripts/Kconfig.include"

source "init/Kconfig"

source "kernel/Kconfig.freezer"

source "fs/Kconfig.binfmt"

source "mm/Kconfig"

source "net/Kconfig"

source "drivers/Kconfig"

source "fs/Kconfig"

source "security/Kconfig"

source "crypto/Kconfig"

source "lib/Kconfig"

source "lib/Kconfig.debug"

source "Documentation/Kconfig"
```

## drivers/contalloc/Kconfig
```kconfig
# SPDX-License-Identifier: GPL-2.0-only
#
# Virtualization support drivers
#

config CONTALLOC_DRIVER
	tristate "Continuous allocator for physical memory."
	help
	  Say Y here to allow the driver to allocate continuous memory. 
```

## drivers/keystone/Kconfig
```kconfig
# SPDX-License-Identifier: GPL-2.0-only
#
# Virtualization support drivers
#

config KEYSTONE_DRIVER
	tristate "Keystone driver"
	help
	  Say Y here to enable the keystone driver
```

## drivers/tyche/Kconfig
```kconfig
# SPDX-License-Identifier: GPL-2.0-only
#
# Virtualization support drivers
#

config TYCHE_DRIVER
	tristate "Tyche Isolation Monitor driver"
	help
	  Say Y here to enable the tyche isolation monitor non-root ring 0 dirver
```
